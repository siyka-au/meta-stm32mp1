## conf/machine/stm32mp157c-odyssey.conf
```bitbake
#@TYPE: Machine
#@NAME: stm32mp157c-odyssey machine
#@DESCRIPTION: Seeed STM32MP157C Odyssey

require conf/machine/include/stm32mp1.inc
include conf/machine/include/arm/armv7a/tune-cortexa7.inc

# Kernel
KERNEL_DEVICETREE ?= "stm32mp157c-odyssey.dtb"

# U-Boot
SPL_BINARY = "u-boot-spl.stm32"
UBOOT_MAKE_TARGET = "DEVICE_TREE=stm32mp157c-odyssey all"
UBOOT_MACHINE = "stm32mp15_basic_defconfig"
UBOOT_EXTLINUX = "1"
UBOOT_EXTLINUX_FDT = "/boot/stm32mp157c-odyssey.dtb"
UBOOT_EXTLINUX_ROOT = "root=/dev/mmcblk0p4"
UBOOT_EXTLINUX_CONSOLE = ""

MACHINE_FEATURES = "usbhost usbgadget alsa ext2 wifi bluetooth"

MACHINE_ESSENTIAL_EXTRA_RDEPENDS += " \
    kernel-image \
    kernel-devicetree \
    kernel-modules \
    u-boot \
    linux-firmware-bcm43430 \
"
```
